/**
 * These arguments were used when this file was generated. They will be automatically applied on subsequent loads
 * via the GUI or CLI. Run CLI with '--help' for additional information on how to override these arguments.
 * @cliArgs --device "MSPM0G350X" --part "Default" --package "LQFP-64(PM)" --product "mspm0_sdk@2.05.01.00"
 * @v2CliArgs --device "MSPM0G3507" --package "LQFP-64(PM)" --product "mspm0_sdk@2.05.01.00"
 * @versions {"tool":"1.24.1+4189"}
 */

/**
 * Import the modules used in this configuration.
 */
const GPIO    = scripting.addModule("/ti/driverlib/GPIO", {}, false);
const GPIO1   = GPIO.addInstance();
const GPIO2   = GPIO.addInstance();
const PWM     = scripting.addModule("/ti/driverlib/PWM", {}, false);
const PWM1    = PWM.addInstance();
const SYSCTL  = scripting.addModule("/ti/driverlib/SYSCTL");
const SYSTICK = scripting.addModule("/ti/driverlib/SYSTICK");
const TIMER   = scripting.addModule("/ti/driverlib/TIMER", {}, false);
const TIMER1  = TIMER.addInstance();
const TIMER2  = TIMER.addInstance();
const UART    = scripting.addModule("/ti/driverlib/UART", {}, false);
const UART1   = UART.addInstance();

/**
 * Write custom configuration values to the imported modules.
 */
GPIO1.port                               = "PORTB";
GPIO1.$name                              = "LED";
GPIO1.associatedPins[0].initialValue     = "SET";
GPIO1.associatedPins[0].internalResistor = "PULL_DOWN";
GPIO1.associatedPins[0].$name            = "D1";
GPIO1.associatedPins[0].assignedPin      = "14";

const Board = scripting.addModule("/ti/driverlib/Board", {}, false);

GPIO2.$name                              = "KEY";
GPIO2.port                               = "PORTB";
GPIO2.associatedPins[0].direction        = "INPUT";
GPIO2.associatedPins[0].assignedPin      = "21";
GPIO2.associatedPins[0].$name            = "S2";
GPIO2.associatedPins[0].internalResistor = "PULL_UP";

PWM1.$name                 = "PWM_0";
PWM1.clockPrescale         = 32;
PWM1.timerStartTimer       = true;
PWM1.pwmMode               = "EDGE_ALIGN_UP";
PWM1.PWM_CHANNEL_0.$name   = "ti_driverlib_pwm_PWMTimerCC0";
PWM1.PWM_CHANNEL_0.ccValue = 500;
PWM1.ccp0PinConfig.$name   = "ti_driverlib_gpio_GPIOPinGeneric0";
PWM1.peripheral.$assign    = "TIMA1";
PWM1.PWM_CHANNEL_1.$name   = "ti_driverlib_pwm_PWMTimerCC1";
PWM1.PWM_CHANNEL_1.ccValue = 500;
PWM1.ccp1PinConfig.$name   = "ti_driverlib_gpio_GPIOPinGeneric1";

SYSCTL.forceDefaultClkConfig = true;

SYSTICK.periodEnable      = true;
SYSTICK.interruptEnable   = true;
SYSTICK.interruptPriority = "0";
SYSTICK.systickEnable     = true;
SYSTICK.period            = 32000;

TIMER1.$name              = "TIMER_1ms";
TIMER1.timerMode          = "PERIODIC_UP";
TIMER1.timerPeriod        = "1 ms";
TIMER1.timerStartTimer    = true;
TIMER1.interrupts         = ["ZERO"];
TIMER1.peripheral.$assign = "TIMA0";

TIMER2.$name            = "TIMER_1s";
TIMER2.timerMode        = "PERIODIC_UP";
TIMER2.timerClkDiv      = 8;
TIMER2.timerClkPrescale = 200;
TIMER2.timerPeriod      = "1s";
TIMER2.timerStartTimer  = true;
TIMER2.interrupts       = ["ZERO"];

UART1.$name                       = "UART_0";
UART1.targetBaudRate              = 115200;
UART1.enableFIFO                  = true;
UART1.txFifoThreshold             = "DL_UART_TX_FIFO_LEVEL_EMPTY";
UART1.enabledInterrupts           = ["DMA_DONE_RX","RX_TIMEOUT_ERROR"];
UART1.enabledDMARXTriggers        = "DL_UART_DMA_INTERRUPT_RX";
UART1.txPinConfig.$name           = "ti_driverlib_gpio_GPIOPinGeneric2";
UART1.rxPinConfig.$name           = "ti_driverlib_gpio_GPIOPinGeneric3";
UART1.DMA_CHANNEL_RX.$name        = "DMA_CH0";
UART1.DMA_CHANNEL_RX.addressMode  = "f2b";
UART1.DMA_CHANNEL_RX.srcLength    = "BYTE";
UART1.DMA_CHANNEL_RX.dstLength    = "BYTE";
UART1.DMA_CHANNEL_RX.transferMode = "FULL_CH_REPEAT_SINGLE";

/**
 * Pinmux solution for unlocked pins/peripherals. This ensures that minor changes to the automatic solver in a future
 * version of the tool will not impact the pinmux you originally saw.  These lines can be completely deleted in order to
 * re-solve from scratch.
 */
GPIO1.associatedPins[0].pin.$suggestSolution     = "PB14";
Board.peripheral.$suggestSolution                = "DEBUGSS";
Board.peripheral.swclkPin.$suggestSolution       = "PA20";
Board.peripheral.swdioPin.$suggestSolution       = "PA19";
GPIO2.associatedPins[0].pin.$suggestSolution     = "PB21";
PWM1.peripheral.ccp0Pin.$suggestSolution         = "PA10";
PWM1.peripheral.ccp1Pin.$suggestSolution         = "PA11";
SYSCTL.peripheral.$suggestSolution               = "SYSCTL";
TIMER2.peripheral.$suggestSolution               = "TIMG0";
UART1.peripheral.$suggestSolution                = "UART0";
UART1.peripheral.rxPin.$suggestSolution          = "PA1";
UART1.peripheral.txPin.$suggestSolution          = "PA0";
UART1.DMA_CHANNEL_RX.peripheral.$suggestSolution = "DMA_CH0";
